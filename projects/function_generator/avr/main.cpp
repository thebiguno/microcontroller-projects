#include <avr/interrupt.h>
#include <avr/io.h>
#include <avr/pgmspace.h> 
#include <stdio.h>
#include <util/delay.h>

#include "lib/Hd44780/Hd44780_Direct_4bit.h"
#include "lib/Button/Buttons.h"
#include "lib/pwm/pwm.h"

#define MODE_FAST_SQUARE	0x00
#define MODE_SQUARE			0x01
#define MODE_SINE			0x02
#define MODE_TRIANGLE		0x03
#define MODE_SAWTOOTH_UP	0x04
#define MODE_SAWTOOTH_DOWN	0x05
#define MODE_STAIRCASE_UP	0x06
#define MODE_STAIRCASE_DOWN	0x07
#define MODE_SERVO			0x08
#define MODE_FIRST			MODE_FAST_SQUARE
#define MODE_LAST 			MODE_SERVO

#define DDS_MAX				745
#define SERVO_MAX			1100

#define BUTTON_MODE			_BV(PORTC1)
#define BUTTON_UP			_BV(PORTC2)
#define BUTTON_DOWN			_BV(PORTC3)

using namespace digitalcave;

const uint8_t data_square[] PROGMEM			=	{0xff,0xff,0xff,0xff,0xff,0xff,0xff,0xff,0xff,0xff,0xff,0xff,0xff,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0x00,0x00};
const uint8_t data_sine[] PROGMEM			=	{0x7f,0x82,0x85,0x88,0x8b,0x8e,0x91,0x94,0x97,0x9b,0x9e,0xa1,0xa4,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0x79,0x7c};
const uint8_t data_triangle[] PROGMEM		=	{0x00,0x02,0x04,0x06,0x08,0x0a,0x0c,0x0e,0x10,0x12,0x14,0x16,0x18,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0x04,0x02};
const uint8_t data_sawtooth_up[] PROGMEM	=	{0x00,0x01,0x02,0x03,0x04,0x05,0x06,0x07,0x08,0x09,0x0a,0x0b,0x0c,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0xfe,0xff};
const uint8_t data_sawtooth_down[] PROGMEM	=	{0xff,0xfe,0xfd,0xfc,0xfb,0xfa,0xf9,0xf8,0xf7,0xf6,0xf5,0xf4,0xf3,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0x01,0x00};
const uint8_t data_staircase_up[] PROGMEM	=	{0x00,0x00,0x00,0x00,0x00,0x00,0x00,0x00,0x00,0x00,0x00,0x00,0x00,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0xe0,0xe0};
const uint8_t data_staircase_down[] PROGMEM	=	{0xe0,0xe0,0xe0,0xe0,0xe0,0xe0,0xe0,0xe0,0xe0,0xe0,0xe0,0xe0,0xe0,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0x00,0x00};

static Hd44780_Direct_4bit display(display.FUNCTION_LINE_2 | display.FUNCTION_SIZE_5x8, &PORTB, 0, &PORTB, 4, &PORTB, 5, &PORTC, 4, &PORTC, 5, &PORTC, 0);
static Buttons buttons(&PORTC, BUTTON_MODE | BUTTON_UP | BUTTON_DOWN, 3, 8, 70, 8);

static uint8_t ui_freq_fast = 0xFF;
static uint16_t ui_freq_dds = DDS_MAX;
static uint16_t ui_freq_servo = SERVO_MAX / 2;

volatile uint8_t _mode = MODE_FIRST;

uint8_t _data[256] __attribute__ ((aligned (256)));	//Copy PROGMEM DDS signals into this buffer.

uint32_t get_fast_square_frequency(){
	//From the datasheet, in the section detailing the output frequency of CTC _mode PWM
	return F_CPU / (2 * (1 + (uint32_t) (255 - ui_freq_fast)));
}

uint16_t get_dds_frequency(){
	//Increment from 10Hz to 1.000kHz in 2Hz increments
	return (double) ((uint16_t) ui_freq_dds * 2) + 10;
}

uint32_t get_servo_phase(){
	//Return a value between 400us and 2600us with an increment of 1us.
	return ((ui_freq_servo * 2) + 400);
}

uint16_t _pwm_micros_to_clicks(uint32_t micros){
	return (((F_CPU / 1000000) * micros) / 8);
}

void update_display(){
	display.clear();
	_delay_ms(1);
	display.setDdramAddress(0x00);
	if (_mode == MODE_FAST_SQUARE){
		display.setText((char*) "Square (Fast)", 13);
	}
	else if (_mode == MODE_SQUARE){
		display.setText((char*) "Square", 6);
	}
	else if (_mode == MODE_SINE){
		display.setText((char*) "Sine", 4);
	}
	else if (_mode == MODE_TRIANGLE){
		display.setText((char*) "Triangle", 8);
	}
	else if (_mode == MODE_SAWTOOTH_UP){
		display.setText((char*) "Sawtooth Up", 11);
	}
	else if (_mode == MODE_SAWTOOTH_DOWN){
		display.setText((char*) "Sawtooth Dn", 11);
	}
	else if (_mode == MODE_STAIRCASE_UP){
		display.setText((char*) "Staircase Up", 12);
	}
	else if (_mode == MODE_STAIRCASE_DOWN){
		display.setText((char*) "Staircase Dn", 12);
	}
	else if (_mode == MODE_SERVO){
		display.setText((char*) "Servo", 5);
	}
	else {
		display.setText((char*) "Unknown", 7);
	}
	
	if (_mode == MODE_SERVO){
		//For servo testing we care about phase, not frequency.  The period is fixed
		// at 20ms (20000us); the phase of the high section will determine the servo's 
		// output angle.  By spec, servos are supposed to listen for values between
		// 1ms and 2ms; however, most servos have some wiggle room and let you set a value
		// from about 0.5ms to 2.5ms.  For this servo test _mode, we support output phases 
		// in this expanded range, in 8us increments.  See get_servo_phase() for exact 
		// implementation details and range.
		uint32_t phase = get_servo_phase();
		char temp[16];
		uint8_t l;
		l = snprintf(temp, 16, "%6d us", (uint16_t) phase);
		display.setDdramAddress(0x40);
		_delay_ms(1);
		display.setText(temp, l);
	}
	else{
		uint32_t frequency;
		if (_mode == MODE_FAST_SQUARE) frequency = get_fast_square_frequency();
		else frequency = get_dds_frequency();
	
		char temp[16];
		uint8_t l;
		if (frequency >= 1000000){
			l = snprintf(temp, 16, "%6.4f MHz", (frequency / 1000000.0));
		}
		else if (frequency >= 1000){
			l = snprintf(temp, 16, " %5.3f kHz", (frequency / 1000.0));
		}
		else {
			l = snprintf(temp, 16, "    %3d Hz", (uint16_t) frequency);
		}
		display.setDdramAddress(0x40);
		display.setText(temp, l);
	}
	
	if (TCCR0B != 0x00 || TCCR1B != 0x00){
		display.setDdramAddress(0x0F);
		char temp[1];
		temp[0] = '#';
		_delay_ms(1);
		display.setText(temp, 1);
	}
	
	_delay_ms(1);
}

void update_fast_square_frequency(){
	OCR0A = (255 - ui_freq_fast);					//Comparator
}

void update_servo_phase(){
	OCR1B = _pwm_micros_to_clicks(get_servo_phase()); //OCR1B controls the PWM phase
}

void update_dds_frequency(){
	uint32_t frequency = get_dds_frequency();
	OCR1A = (F_CPU / 256 / frequency) - 1;			//Comparison value
}

void main_menu(){
	update_display();
	
	while(1){
		_delay_ms(12);
		buttons.sample();

		uint8_t pressed = buttons.pressed();
		uint8_t released = buttons.released();
		uint8_t held = buttons.held();
		uint8_t repeat = buttons.repeat();

		if (released & BUTTON_MODE){
			_mode++;
			if (_mode > MODE_LAST){
				_mode = MODE_FIRST;
			}
			update_display();
		}
		else if (held & BUTTON_MODE){
			update_display();
			return;
		}
		
		if (_mode == MODE_FAST_SQUARE){
			if (pressed & BUTTON_UP){
				ui_freq_fast++;
				update_display();
			}
			else if (pressed & BUTTON_DOWN){
				ui_freq_fast--;
				update_display();
			}
			else if (repeat & BUTTON_UP){
				ui_freq_fast += 4;
				update_display();
			}
			else if (repeat & BUTTON_DOWN){
				ui_freq_fast -= 4;
				update_display();
			}
		}
		else if (_mode == MODE_SERVO){
			if (pressed & BUTTON_UP){
				ui_freq_servo++;
				if (ui_freq_servo >= SERVO_MAX) ui_freq_servo = 0;
				update_display();
			}
			else if (pressed & BUTTON_DOWN){
				ui_freq_servo--;
				if (ui_freq_servo >= SERVO_MAX) ui_freq_servo = SERVO_MAX;
				update_display();
			}
			else if (repeat & BUTTON_UP){
				ui_freq_servo += 10;
				if (ui_freq_servo >= SERVO_MAX) ui_freq_servo = 0;
				update_display();
			}
			else if (repeat & BUTTON_DOWN){
				ui_freq_servo -= 10;
				if (ui_freq_servo >= SERVO_MAX) ui_freq_servo = SERVO_MAX;
				update_display();
			}
		}
		else {
			if (pressed & BUTTON_UP){
				ui_freq_dds++;
				if (ui_freq_dds >= DDS_MAX) ui_freq_dds = 0;
				update_display();
			}
			else if (pressed & BUTTON_DOWN){
				ui_freq_dds--;
				if (ui_freq_dds >= DDS_MAX) ui_freq_dds = DDS_MAX;
				update_display();
			}
			else if (repeat & BUTTON_UP){
				ui_freq_dds += 10;
				if (ui_freq_dds >= DDS_MAX) ui_freq_dds = 0;
				update_display();
			}
			else if (repeat & BUTTON_DOWN){
				ui_freq_dds -= 10;
				if (ui_freq_dds >= DDS_MAX) ui_freq_dds = DDS_MAX;
				update_display();
			}
		}
	}
}

void fast_square_menu(){
	update_display();

	while(1){	//Timers do everything now.
		_delay_ms(12);
		buttons.sample();
		
		uint8_t pressed = buttons.pressed();
		uint8_t held = buttons.held();
		uint8_t repeat = buttons.repeat();

		if (held & BUTTON_MODE){
			TCCR0B = 0x00;
			TIMSK0 = 0x00;
			update_display();
			return;
		}
		else if (pressed & BUTTON_UP){
			ui_freq_fast++;
			update_display();
			update_fast_square_frequency();
		}
		else if (pressed & BUTTON_DOWN){
			ui_freq_fast--;
			update_display();
			update_fast_square_frequency();
		}
		else if (repeat & BUTTON_UP){
			ui_freq_fast += 4;
			update_display();
			update_fast_square_frequency();
		}
		else if (repeat & BUTTON_DOWN){
			ui_freq_fast -= 4;
			update_display();
			update_fast_square_frequency();
		}
	}
}

void dds_menu(){
	update_display();

	while(1){	//Timers do everything now.
		_delay_ms(12);
		buttons.sample();
		
		uint8_t pressed = buttons.pressed();
		uint8_t held = buttons.held();
		uint8_t repeat = buttons.repeat();

		if (held & BUTTON_MODE){
			TCCR1B = 0x00;
			TIMSK1 = 0x00;
			update_display();
			return;
		}
		else if (pressed & BUTTON_UP){
			ui_freq_dds++;
			if (ui_freq_dds >= DDS_MAX) ui_freq_dds = 0;
			update_display();
			update_dds_frequency();
		}
		else if (pressed & BUTTON_DOWN){
			ui_freq_dds--;
			if (ui_freq_dds >= DDS_MAX) ui_freq_dds = DDS_MAX;
			update_display();
			update_dds_frequency();
		}
		else if (repeat & BUTTON_UP){
			ui_freq_dds += 4;
			if (ui_freq_dds >= DDS_MAX) ui_freq_dds = 0;
			update_display();
			update_dds_frequency();
		}
		else if (repeat & BUTTON_DOWN){
			ui_freq_dds -= 4;
			if (ui_freq_dds >= DDS_MAX) ui_freq_dds =DDS_MAX;
			update_display();
			update_dds_frequency();
		}
	}
}

void servo_menu(){
	update_display();

	while(1){
		_delay_ms(12);
		buttons.sample();
		
		uint8_t pressed = buttons.pressed();
		uint8_t held = buttons.held();
		uint8_t repeat = buttons.repeat();

		if (held & BUTTON_MODE){
			TCCR1B = 0x00;
			PORTC &= ~_BV(PORTC5);
			update_display();
			return;
		}
		else if (pressed & BUTTON_UP){
			ui_freq_servo++;
			update_display();
			update_servo_phase();
		}
		else if (pressed & BUTTON_DOWN){
			ui_freq_servo--;
			update_display();
			update_servo_phase();
		}
		else if (repeat & BUTTON_UP){
			ui_freq_servo += 4;
			update_display();
			update_servo_phase();
		}
		else if (repeat & BUTTON_DOWN){
			ui_freq_servo -= 4;
			update_display();
			update_servo_phase();
		}
	}
}

void output_waveform(){
	if (_mode == MODE_FAST_SQUARE){
		TCCR0A = _BV(COM0A0) | _BV(WGM01);			//CTC Mode (mode 2), Toggle OC0A on compare match
		TCCR0B = _BV(CS00);							//No prescaler
		update_fast_square_frequency();
		TCNT0 = 0;
		sei();
		
		fast_square_menu();
	}
	else if (_mode == MODE_SERVO){
		OCR1A = _pwm_micros_to_clicks(20000); //OCR1A controls the PWM period
		update_servo_phase();
		
		//Enable compare interrupt on both channels
		TIMSK1 = _BV(OCIE1A) | _BV(OCIE1B);

		TCNT1 = 0x00;
		TCCR1A = 0x00;
		TCCR1B |= _BV(CS11);		//Div 8 prescaler
		sei();
		
		servo_menu();
	}
	else {
		const uint8_t* progmem_pointer;
		
		//Figure out which DDS mode we are in
		if (_mode == MODE_SQUARE) progmem_pointer = data_square;
		else if (_mode == MODE_SINE) progmem_pointer = data_sine;
		else if (_mode == MODE_TRIANGLE) progmem_pointer = data_triangle;
		else if (_mode == MODE_SAWTOOTH_UP) progmem_pointer = data_sawtooth_up;
		else if (_mode == MODE_SAWTOOTH_DOWN) progmem_pointer = data_sawtooth_down;
		else if (_mode == MODE_STAIRCASE_UP) progmem_pointer = data_staircase_up;
		else if (_mode == MODE_STAIRCASE_DOWN) progmem_pointer = data_staircase_down;
		else return;
	
		//Copy from PROGMEM to RAM buffer
		for (uint16_t i = 0; i <= 0xFF; i++){
			_data[i] = pgm_read_byte_near(progmem_pointer + i);
		}
		
		TIMSK1 = _BV(TOIE1);								//Enable timer1 overflow interrupts
		TCNT1 = 0;
		sei();
		update_dds_frequency();
		TCCR1A = _BV(WGM11) | _BV(WGM10);					//Fast PWM mode 15
		TCCR1B = _BV(WGM13) | _BV(WGM12) | _BV(CS10);		//No prescaler

		dds_menu();
	}
}

int main (void){
	//Init port D and PORTC5 in output mode (used to send data to DAC and to servo, respectively)
	DDRD = 0xFF;
 	DDRC |= _BV(PORTC5);

	//Infinite loop of picking menu options, then outputting waveform.
	// Hold the mode button to stop / start signal generation.
	while (1) {
		//Pick mode / options
		main_menu();

		//Output waveform
		output_waveform();
	}
}

/* 
 * The frequency comparison.  When it overflows, we reset the timer to 0.
 */
/*
ISR(TIMER1_OVF_vect){
	PORTD = _data[_data_ptr];
	_data_ptr += _dds_increment;
}
*/
ISR(TIMER1_COMPA_vect){	
	//Servo mode
	TCNT1 = 0;
	PORTC |= _BV(PORTD5);	
}

/*
ISR(TIMER1_COMPB_vect){
	PORTC &= ~_BV(PORTC5);
}
*/